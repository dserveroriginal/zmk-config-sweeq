## boards/shields/sweeq/Kconfig.shield
```kconfig
# No whitespace after the comma or in your part name!
config SHIELD_SWEEQ_LEFT
    def_bool $(shields_list_contains,sweeq_left)

# No whitespace after the comma or in your part name!
config SHIELD_SWEEQ_RIGHT
    def_bool $(shields_list_contains,sweeq_right)
```
